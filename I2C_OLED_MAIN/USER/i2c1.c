#include "stm32f10x.h"                  // Device header
#include "stm32f10x_gpio.h"             // Keil::Device:StdPeriph Drivers:GPIO
#include "stm32f10x_i2c.h"              // Keil::Device:StdPeriph Drivers:I2C
#include "stm32f10x_rcc.h"              // Keil::Device:StdPeriph Drivers:RCC

uint8_t ADDRESS = 0x3c;
GPIO_InitTypeDef GPIO_InitStructure;
I2C_InitTypeDef I2C_InitStructure;

void delay_ms(uint8_t time);

void i2c_init(void)
{
	RCC_APB2PeriphClockCmd(RCC_APB2Periph_GPIOB,ENABLE);
	RCC_APB1PeriphClockCmd(RCC_APB1Periph_I2C1,ENABLE);

	GPIO_InitStructure.GPIO_Pin = GPIO_Pin_6 | GPIO_Pin_7;
	GPIO_InitStructure.GPIO_Mode = GPIO_Mode_AF_OD;
	GPIO_InitStructure.GPIO_Speed = GPIO_Speed_50MHz;
	GPIO_Init(GPIOB,&GPIO_InitStructure);
	
	I2C_InitStructure.I2C_Ack = I2C_Ack_Disable;
	I2C_InitStructure.I2C_AcknowledgedAddress = I2C_AcknowledgedAddress_7bit;
	I2C_InitStructure.I2C_ClockSpeed = 500000;
	I2C_InitStructure.I2C_DutyCycle = I2C_DutyCycle_2;
	I2C_InitStructure.I2C_Mode = I2C_Mode_I2C;
	I2C_InitStructure.I2C_OwnAddress1 = 0;
	
	I2C_Init(I2C1,&I2C_InitStructure);
	I2C_Cmd(I2C1,ENABLE);
}

void i2c_send_byte(uint8_t CONTROL, uint8_t Data)
{
	I2C_GenerateSTART(I2C1,ENABLE);
	while(!I2C_CheckEvent(I2C1,I2C_EVENT_MASTER_MODE_SELECT));
	I2C_Send7bitAddress(I2C1,ADDRESS,I2C_Direction_Transmitter);
	while(!I2C_CheckEvent(I2C1,I2C_EVENT_MASTER_TRANSMITTER_MODE_SELECTED));
	I2C_SendData(I2C1,CONTROL);
	while(!I2C_CheckEvent(I2C1,I2C_EVENT_MASTER_BYTE_TRANSMITTED));
	I2C_SendData(I2C1,Data);
	while(!I2C_CheckEvent(I2C1,I2C_EVENT_MASTER_BYTE_TRANSMITTED));
	I2C_GenerateSTOP(I2C1,ENABLE);
}

void delay_ms(uint8_t time)
{	int i ,j;
	for( i = 0 ; i<time ; i++)
	{	
		for( j = 0; j< 0x2aff ;j++)
		{}
	}
}

void Write_Cmd(unsigned char I2C_Command)
{
	i2c_send_byte(0x00,I2C_Command);
}

void Write_Data(unsigned char Data)
{
	i2c_send_byte(0x40,Data);
}

void ssd1306_i2c_init(void)
{
// Sends the init commands to the display
    Write_Cmd(0xAE);
    Write_Cmd(0x00 | 0x0);      // low col = 0
    Write_Cmd(0x10 | 0x0);      // hi col = 0
    Write_Cmd(0x40 | 0x0);      // line #0
    Write_Cmd(0x81);            // Set Contrast 0x81
    Write_Cmd(0xCF);
    Write_Cmd(0xA1);            // Segremap - 0xA1
    Write_Cmd(0xC8);            // COMSCAN DEC 0xC8 C0
    Write_Cmd(0xA6);            // Normal Display 0xA6 (Invert A7)
    Write_Cmd(0xA4);            // DISPLAY ALL ON RESUME - 0xA4
    Write_Cmd(0xA8);            // Set Multiplex 0xA8
    Write_Cmd(0x3F);            // 1/64 Duty Cycle 
    Write_Cmd(0xD3);            // Set Display Offset 0xD3
    Write_Cmd(0x0);             // no offset
    Write_Cmd(0xD5);            // Set Display Clk Div 0xD5
    Write_Cmd(0x80);            // Recommneded resistor ratio 0x80
    Write_Cmd(0xD9);            // Set Precharge 0xd9
    Write_Cmd(0xF1);
    Write_Cmd(0xDA);            // Set COM Pins0xDA
    Write_Cmd(0x12);
    Write_Cmd(0xDB);            // Set VCOM Detect - 0xDB
    Write_Cmd(0x40);
    Write_Cmd(0x20);            // Set Memory Addressing Mode
    Write_Cmd(0x00);            // 0x00 - Horizontal
    Write_Cmd(0x40 | 0x0);      // Set start line at line 0 - 0x40 
    Write_Cmd(0x8D);            // Charge Pump -0x8D
    Write_Cmd(0x14);
    Write_Cmd(0xA4);            //--turn on all pixels - A5. Regular mode A4
    Write_Cmd(0xAF);            //--turn on oled panel - AF
}

void OLED_ON(void)
{
	Write_Cmd(0X8D);  //
	Write_Cmd(0X14);  //
	Write_Cmd(0XAF);  //
}

void OLED_OFF(void)
{
	Write_Cmd(0X8D);  //
	Write_Cmd(0X10);  //
	Write_Cmd(0XAE);  //
}

void OLED_SetPos(unsigned char x, unsigned char y)
{ 
	Write_Cmd(0xb0+y);
	Write_Cmd(((x&0xf0)>>4)|0x10);
	Write_Cmd((x&0x0f)|0x01);
}

void OLED_Fill(unsigned char fill_Data)
{
	unsigned char m,n;
	for(m=0;m<8;m++)
	{
		Write_Cmd(0xb0+m);		//page0-page7
		Write_Cmd(0x00);		//low column start address
		Write_Cmd(0x10);		//high column start address
		for(n=0;n<128;n++)
			{
				Write_Data(fill_Data);
			}
	}
}

void OLED_CLS(void)
{
	OLED_Fill(0x00);
}

const unsigned char F6x8[][6] =
{
	0x00, 0x00, 0x00, 0x00, 0x00, 0x00,// sp
	0x00, 0x00, 0x00, 0x2f, 0x00, 0x00,// !
	0x00, 0x00, 0x07, 0x00, 0x07, 0x00,// "
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	0x14, 0x14, 0x14, 0x14, 0x14, 0x14,// horiz lines
};

void OLED_ShowStr(unsigned char x, unsigned char y, unsigned char ch[], unsigned char TextSize)
{
	unsigned char c = 0,i = 0,j = 0;
	switch(TextSize)
	{
		case 1:
		{
			while(ch[j] != '\0')
			{
				c = ch[j] - 32;
				if(x > 126)
				{
					x = 0;
					y++;
				}
				OLED_SetPos(x,y);
				for(i=0;i<6;i++)
					Write_Data(F6x8[c][i]);
				x += 6;
				j++;
			}
		}break;
	}
}

void OLED_DrawBMP(unsigned char x0, unsigned char y0, unsigned char x1, unsigned char y1, unsigned char BMP[])
{
	unsigned int j=0;
	unsigned char x,y;

  if(y1%8==0)
		y = y1/8;
  else
		y = y1/8 + 1;
	for(y=y0;y<y1;y++)
	{
		OLED_SetPos(x0,y);
    for(x=x0;x<x1;x++)
		{
			Write_Data(BMP[j++]);
		}
	}
}
